## demos/S3.0/main/Kconfig.projbuild
```kconfig
menu "Agent Robot S3 Demo"

config VOICE_DEMO_WS_URI
    string "Voice Demo Host WebSocket URI"
    default ""
    help
        Unauthenticated development endpoint, for example
        ws://192.168.31.10:8787/ws. This value belongs to the local sdkconfig
        and must not contain credentials.

endmenu
```

## firmware/sdkconfig.defaults
```kconfig
# ESP32-S3-DevKitC-1 v1.1 / ESP32-S3-WROOM-1-N8R8
CONFIG_IDF_TARGET="esp32s3"
CONFIG_ESPTOOLPY_FLASHSIZE_8MB=y
CONFIG_ESPTOOLPY_FLASHSIZE="8MB"

CONFIG_SPIRAM=y
CONFIG_SPIRAM_MODE_OCT=y
CONFIG_SPIRAM_SPEED_80M=y
CONFIG_SPIRAM_BOOT_INIT=y
CONFIG_SPIRAM_USE_MALLOC=y
CONFIG_SPIRAM_MEMTEST=y

CONFIG_LOG_DEFAULT_LEVEL_INFO=y
CONFIG_MBEDTLS_SSL_KEEP_PEER_CERTIFICATE=y
CONFIG_ESP_CONSOLE_USB_SERIAL_JTAG=y
CONFIG_ESP_CONSOLE_SECONDARY_NONE=y

CONFIG_PARTITION_TABLE_CUSTOM=y
CONFIG_PARTITION_TABLE_CUSTOM_FILENAME="partitions.csv"

CONFIG_LV_COLOR_DEPTH_16=y
CONFIG_LV_FONT_MONTSERRAT_28=y
CONFIG_FREERTOS_USE_TRACE_FACILITY=y
```

## main/Kconfig.projbuild
```kconfig
menu "Agent Terminal Configuration"

    config AGENT_WIFI_SSID
        string "WiFi SSID"
        default "MyWiFi"

    config AGENT_WIFI_PASS
        string "WiFi Password"
        default ""

    config AGENT_WS_URI
        string "Agent WebSocket URI"
        default "ws://192.168.1.100:8080/ws"

    config AGENT_DEVICE_NAME
        string "Device name reported to agent"
        default "agent-robot-1"

endmenu
```
